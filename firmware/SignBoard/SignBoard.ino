// SignBoard - draw on an iPad, see it on an SSD1306 OLED.
//
// HTTP  :80  serves the web app (embedded in web_assets.h)
// WS    :81  receives 1024-byte binary frames in SSD1306 page format

#include <WiFi.h>
#include <WebServer.h>
#include <ESPmDNS.h>
#include <WebSocketsServer.h>  // "WebSockets" by Markus Sattler

#include "config.h"
#include "display_driver.h"
#include "web_assets.h"  // generated by tools/embed_web.py

WebServer http(HTTP_PORT);
WebSocketsServer ws(WS_PORT);

void onWsEvent(uint8_t client, WStype_t type, uint8_t *payload, size_t len) {
  switch (type) {
    case WStype_CONNECTED:
      Serial.printf("[ws] client %u connected from %s\n", client, ws.remoteIP(client).toString().c_str());
      break;
    case WStype_DISCONNECTED:
      Serial.printf("[ws] client %u disconnected\n", client);
      break;
    case WStype_BIN:
      if (len == FRAME_SIZE) {
        displayFrame(payload);
      } else {
        Serial.printf("[ws] rejected %u-byte frame from client %u\n", (unsigned)len, client);
        ws.sendTXT(client, "error: expected a 1024-byte binary frame");
      }
      break;
    default:
      break;
  }
}

void connectWiFi() {
  WiFi.setHostname(HOSTNAME);
  WiFi.mode(WIFI_STA);
  WiFi.setSleep(false);  // modem sleep adds 100ms+ of latency per frame
  WiFi.begin(WIFI_SSID, WIFI_PASS);

  Serial.printf("Connecting to %s", WIFI_SSID);
  displayText("Connecting to WiFi", WIFI_SSID);
  const uint32_t start = millis();
  while (WiFi.status() != WL_CONNECTED) {
    if (millis() - start > WIFI_TIMEOUT_MS) {
      Serial.println("\nWiFi timeout, restarting");
      displayText("WiFi failed", "Restarting...");
      delay(1000);
      ESP.restart();
    }
    delay(250);
    Serial.print('.');
  }
  Serial.printf("\nConnected, IP %s\n", WiFi.localIP().toString().c_str());
}

void setup() {
  Serial.begin(115200);

  if (!displayBegin()) {
    Serial.printf("OLED not found at 0x%02X - check wiring and OLED_I2C_ADDR\n", OLED_I2C_ADDR);
  }

  connectWiFi();

  if (!MDNS.begin(HOSTNAME)) Serial.println("mDNS failed, use the IP address");

  for (const WebAsset &asset : WEB_ASSETS) {
    http.on(asset.path, HTTP_GET, [&asset] { http.send_P(200, asset.mime, asset.body); });
  }
  http.begin();

  ws.begin();
  ws.onEvent(onWsEvent);
  ws.enableHeartbeat(15000, 3000, 2);  // drop iPads that went to sleep without closing

  String ip = WiFi.localIP().toString();
  displayText(HOSTNAME ".local", ip.c_str());
  Serial.printf("Open http://%s.local or http://%s on the iPad\n", HOSTNAME, ip.c_str());
}

void loop() {
  http.handleClient();
  ws.loop();
}
